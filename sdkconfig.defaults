## sdkconfig.defaults
```kconfig
# Flash size — Heltec V3 has 8MB, default ESP-IDF sets 2MB
CONFIG_ESPTOOLPY_FLASHSIZE_8MB=y
CONFIG_ESPTOOLPY_FLASHSIZE="8MB"

# Bluetooth — NimBLE BLE scanning (Phase 1)
CONFIG_BT_ENABLED=y
CONFIG_BT_BLUEDROID_ENABLED=n
CONFIG_BT_NIMBLE_ENABLED=y
CONFIG_BT_CONTROLLER_ENABLED=y
CONFIG_BT_CONTROLLER_ONLY=y
CONFIG_BT_CTRL_MODE_EFF=1
CONFIG_BT_CTRL_BLE_SCAN_DUPL=y
CONFIG_BT_BLE_CCA_MODE=0
CONFIG_BT_BLE_CCA_MODE_NONE=y
CONFIG_BT_NIMBLE_LEGACY_VHCI_ENABLE=y
CONFIG_BT_NIMBLE_CRYPTO_STACK_MBEDTLS=y
CONFIG_BT_NIMBLE_50_FEATURE_SUPPORT=y
CONFIG_BT_NIMBLE_ROLE_OBSERVER=y
CONFIG_BT_NIMBLE_MEM_ALLOC_MODE_INTERNAL=y
CONFIG_BT_NIMBLE_MAX_CONNECTIONS=1
CONFIG_BT_NIMBLE_HOST_TASK_STACK_SIZE=4096
CONFIG_NIMBLE_ROLE_OBSERVER=y
CONFIG_NIMBLE_MAX_CONNECTIONS=1
CONFIG_NIMBLE_MEM_ALLOC_MODE_INTERNAL=y
```

## sdkconfig.defaults.tdeck
```kconfig
# ================================================================
# T-Deck (Lilygo) sdkconfig overrides — layered on sdkconfig.defaults
# Use with: idf.py -DBOARD=tdeck \
#   -DSDKCONFIG_DEFAULTS="sdkconfig.defaults;sdkconfig.defaults.tdeck" build
# ================================================================

# ESP32-S3-WROOM-1 N16R8: 16MB flash
CONFIG_ESPTOOLPY_FLASHSIZE_16MB=y
CONFIG_ESPTOOLPY_FLASHSIZE="16MB"

# Octal PSRAM (8MB) — required for the 320x240x16 ST7789 framebuffer (~150KB).
# If the panel never lights up and boot logs a PSRAM error, the module may be
# quad PSRAM instead: swap MODE_OCT for MODE_QUAD.
CONFIG_SPIRAM=y
CONFIG_SPIRAM_MODE_OCT=y
CONFIG_SPIRAM_SPEED_80M=y
CONFIG_SPIRAM_USE_MALLOC=y
# WiFi/LWIP buffers stay in internal RAM (not PSRAM): with LoRa+TFT doing
# concurrent SPI-DMA, WiFi buffers in PSRAM destabilize coexistence.
# CONFIG_SPIRAM_TRY_ALLOCATE_WIFI_LWIP is not set

# Route the console to USB-Serial-JTAG (T-Deck has no USB-UART bridge; UART0
# isn't on the USB port). Lets boot logs come out over /dev/ttyACM0.
CONFIG_ESP_CONSOLE_USB_SERIAL_JTAG=y

# T-Deck board.init() runs a deep chain on the main task (esp_lcd + FATFS mount
# + SX1262 init); the 3584-byte default overflows and corrupts WiFi coex.
CONFIG_ESP_MAIN_TASK_STACK_SIZE=16384
```
